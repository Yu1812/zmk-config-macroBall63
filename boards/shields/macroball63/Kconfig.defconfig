## boards/shields/macroball63/Kconfig.defconfig
```kconfig
if SHIELD_macroball63_R

config ZMK_KEYBOARD_NAME
    default "macroball63_R"

config ZMK_SPLIT
    default y

config ZMK_SPLIT_ROLE_CENTRAL
    default y

endif

if SHIELD_ROBA_L

config ZMK_KEYBOARD_NAME
    default "macroball63_L"

config ZMK_SPLIT
    default y

endif
```

## boards/shields/macroball63/Kconfig.shield
```kconfig
config SHIELD_macroball63_R
    def_bool $(shields_list_contains,macroball63_R)

config SHIELD_macroball63_L
    def_bool $(shields_list_contains,macroball63_L)
```
